## components/bsp/Kconfig
```kconfig
menu "AI Passport BSP"
    config BSP_LVGL_TASK_STACK_SIZE
        int "LVGL task stack size in bytes"
        range 7168 32768
        default 16384
        help
            Nested layout containers increase the recursive LVGL drawing stack.
            The OpenSwiftUI List demo exceeds the port's 7168-byte default.

    config BSP_USB_MIRRORING_ENABLED
        bool "Enable USB display mirroring"
        default y
        help
            Retains a bounded RGB565 row queue and a transmission task for
            development-time screen mirroring.
endmenu
```

## main/Kconfig.projbuild
```kconfig
menu "AI Passport application"
    config APP_EMBEDDED_SWIFTUI_DEMO
        bool "Start the EmbeddedSwiftUI demo"
        default y
        select LV_USE_FLEX
        select LV_USE_IMAGE
        select LV_FONT_MONTSERRAT_12
        select LV_FONT_MONTSERRAT_14
        select LV_FONT_MONTSERRAT_16
        select LV_FONT_MONTSERRAT_18
        select LV_FONT_MONTSERRAT_20
        select LV_FONT_MONTSERRAT_24
        select LV_FONT_MONTSERRAT_28
        help
            Run the declarative App/WindowGroup MVP. OK switches between List
            and ScrollView; UP/DOWN scroll. Long OK returns to List. This is the
            only application configuration currently included in the build.
endmenu
```
